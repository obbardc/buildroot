## boot/efibootguard/Config.in
```kconfig
config BR2_TARGET_EFIBOOTGUARD_ARCH_SUPPORTS
	bool
	default y if BR2_x86_64
	depends on BR2_USE_MMU

config BR2_TARGET_EFIBOOTGUARD
	bool "efibootguard"
	depends on BR2_TARGET_EFIBOOTGUARD_ARCH_SUPPORTS
	depends on BR2_USE_WCHAR
	select BR2_PACKAGE_GNU_EFI
	select BR2_PACKAGE_PCIUTILS if BR2_TARGET_EFIBOOTGUARD_INSTALL_TOOLS
	help
	  EFI Boot Guard is a UEFI bootloader intended for robust
	  A/B style updates. It arms a hardware watchdog before
	  handing over control to the OS and supports a fail-safe
	  boot mechanism to roll back if a boot attempt fails.

	  https://github.com/siemens/efibootguard

if BR2_TARGET_EFIBOOTGUARD

config BR2_TARGET_EFIBOOTGUARD_X86_64
	bool "x86-64"
	depends on BR2_x86_64
	help
	  Select this option if the platform you're targeting has a
	  64 bits EFI BIOS.

config BR2_TARGET_EFIBOOTGUARD_INSTALL_TOOLS
	bool "install tools"
	help
	  Install the efibootguard user-space tools (e.g.
	  bg_printenv and bg_setenv) on the target. These tools
	  allow reading and updating efibootguard's configuration
	  in user-space.

endif # BR2_TARGET_EFIBOOTGUARD
```

## boot/efibootguard/Config.in.host
```kconfig
config BR2_TARGET_HOST_EFIBOOTGUARD
	bool "host efibootguard"
	help
	  Build EFI Boot Guard companion tools for the host. These
	  can be used during image creation to inspect and
	  modify the EFI Boot Guard configuration data.

	  https://github.com/siemens/efibootguard
```

## boot/ukiboot/Config.in
```kconfig
config BR2_TARGET_UKIBOOT
	bool "ukiboot"
	depends on BR2_PACKAGE_GNU_EFI_ARCH_SUPPORTS
	depends on BR2_USE_WCHAR
	depends on BR2_TOOLCHAIN_USES_GLIBC
	select BR2_PACKAGE_GNU_EFI
	select BR2_PACKAGE_PCIUTILS
	help
	  EFI Boot Guard is a UEFI bootloader intended for robust
	  A/B style updates. It arms a hardware watchdog before
	  handing over control to the OS and supports a fail-safe
	  boot mechanism to roll back if a boot attempt fails.

	  https://github.com/siemens/efibootguard

if BR2_TARGET_UKIBOOT

config BR2_TARGET_UKIBOOT_INSTALL_TOOLS
	bool "install tools"
	help
	  Install the EFI Boot Guard user-space tools (e.g.
	  bg_printenv and bg_setenv) on the target. These tools
	  allow reading and updating EFI Boot Guard configuration
	  in user-space.

endif # BR2_TARGET_UKIBOOT

comment "ukiboot needs a glibc toolchain w/ wchar"
	depends on BR2_PACKAGE_GNU_EFI_ARCH_SUPPORTS
	depends on !BR2_USE_WCHAR || !BR2_TOOLCHAIN_USES_GLIBC
```

## configs/pc_x86_64_efibootguard_defconfig
```kconfig
BR2_x86_64=y
BR2_TOOLCHAIN_EXTERNAL=y
BR2_TOOLCHAIN_EXTERNAL_BOOTLIN_X86_64_GLIBC_STABLE=y
BR2_DOWNLOAD_FORCE_CHECK_HASHES=y
BR2_INIT_SYSTEMD=y
BR2_TARGET_GENERIC_GETTY_PORT="tty1"
BR2_ROOTFS_OVERLAY="board/pc-efibootguard/rootfs-overlay"
BR2_ROOTFS_POST_IMAGE_SCRIPT="board/pc-efibootguard/post-image.sh"
BR2_LINUX_KERNEL=y
BR2_LINUX_KERNEL_DEFCONFIG="x86_64"
BR2_LINUX_KERNEL_CONFIG_FRAGMENT_FILES="board/pc-efibootguard/linux.fragment"
BR2_LINUX_KERNEL_NEEDS_HOST_OPENSSL=y
BR2_LINUX_KERNEL_NEEDS_HOST_LIBELF=y
BR2_TARGET_ROOTFS_EXT2=y
BR2_TARGET_ROOTFS_EXT2_4=y
BR2_TARGET_ROOTFS_EXT2_SIZE="120M"
# BR2_TARGET_ROOTFS_TAR is not set
BR2_TARGET_EFIBOOTGUARD=y
BR2_TARGET_EFIBOOTGUARD_INSTALL_TOOLS=y
BR2_TARGET_HOST_EFIBOOTGUARD=y
BR2_PACKAGE_HOST_DOSFSTOOLS=y
BR2_PACKAGE_HOST_GENIMAGE=y
BR2_PACKAGE_HOST_MTOOLS=y
BR2_PACKAGE_HOST_OSSLSIGNCODE=y
```

## package/dtui/Config.in
```kconfig
config BR2_PACKAGE_DTUI
	bool "dtui"
	depends on BR2_PACKAGE_HOST_RUSTC_TARGET_ARCH_SUPPORTS
	select BR2_PACKAGE_HOST_RUSTC
	help
	  Small TUI for introspecting the state of the system/session
	  D-Bus. It shows current services and lets you introspect
	  objects and their interfaces.

	  https://github.com/Troels51/dtui
```

## package/osslsigncode/Config.in.host
```kconfig
config BR2_PACKAGE_HOST_OSSLSIGNCODE
	bool "host osslsigncode"
	help
	  osslsigncode is an OpenSSL-based Authenticode signing tool for
	  PE, MSI, CAB and CAT files. It can be used at image assembly
	  time to sign PE/EFI binaries (such as bootloaders and unified
	  kernel images) for UEFI Secure Boot.

	  https://github.com/mtrojnar/osslsigncode
```
